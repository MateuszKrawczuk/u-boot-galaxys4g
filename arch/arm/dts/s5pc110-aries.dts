// SPDX-License-Identifier: GPL-2.0+
/*
 * Samsung's S5PC110-based first generation Galaxy S common board device tree source
 *
 * Copyright (c) 2014 Google, Inc
 */

/dts-v1/;

#include "skeleton.dtsi"
#include "s5pc110.dtsi"
#include "s5pc110-pinctrl.dtsi"

/ {
	model = "Samsung Aries based on S5PC110";
	compatible = "samsung,aries", "samsung,s5pc110";

	framebuffer {
		compatible = "simple-framebuffer";
		reg = <0x4ec00000 0x177000>;
		width = <480>;
		height = <800>;
		format = "a8b8g8r8";
	};
};
