// SPDX-License-Identifier: GPL-2.0+
/*
 * Samsung's S5PC110-based Goni board device tree source
 *
 * Copyright (c) 2014 Google, Inc
 */

/dts-v1/;

#include "skeleton.dtsi"
#include "s5pc110.dtsi"

/ {
	model = "Samsung Goni based on S5PC110";
	compatible = "samsung,goni", "samsung,s5pc110";

};
